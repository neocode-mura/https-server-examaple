## main/Kconfig.projbuild
```kconfig
menu "SoftAP Configuration"

	config SOFTAP_SEL
		bool "softAP sel"
		default y

    config ESP_WIFI_SSID
        string "WiFi SSID"
        default "myssid"
        help
            SSID (network name) for the example to connect to.

    config ESP_WIFI_PASSWORD
        string "WiFi Password"
        default "mypassword"
        help
            WiFi password (WPA or WPA2) for the example to use.
    config ESP_WIFI_CHANNEL
        int "WiFi Channel"
        range 1 13
        default 1
        help
            WiFi channel (network channel) for the example to use.

    config ESP_MAX_STA_CONN
        int "Maximal STA connections"
        default 4
        help
            Max number of the STA connects to AP.
endmenu

menu "mDNS Configuration"

    config MDNS_HOSTNAME
        string "mDNS Hostname"
        default "esp32-mdns"
        help
            mDNS Hostname for example to use

    config MDNS_INSTANCE
        string "mDNS Instance Name"
        default "ESP32 with mDNS"
        help
            mDNS Instance Name for example to use

    config MDNS_RESOLVE_TEST_SERVICES
        bool "Resolve test services"
        default n
        help
            Enable resolving test services on startup.
            These services are advertized and evaluated in automated tests.
            When executed locally, these will not be resolved and warnings appear in the log.
            Please set to false to disable initial querying to avoid warnings.

    config MDNS_ADD_MAC_TO_HOSTNAME
        bool "Add mac suffix to hostname"
        default n
        help
            If enabled, a portion of MAC address is added to the hostname, this is used
            for evaluation of tests in CI

endmenu
```
